## Kconfig
```kconfig
mainmenu "EdgeOS Kernel Configuration"

menu "General setup"

choice
    prompt "Target architecture"
    default ARCH_X86_64

config ARCH_X86_64
    bool "x86_64"

config ARCH_ARM64
    bool "ARM64"

endchoice

config KERNEL_VERSION
    string "EdgeOS kernel version"
    default "2.0.8"
    help
      Product release used by the EdgeOS boot banner and build metadata.

config KERNEL_VERSION_APPEND
    string "Local version - append to kernel release"
    default "+arm64" if ARCH_ARM64
    default "+86_64"
    help
      Architecture suffix appended to the EdgeOS product release.

config LINUX_ABI_RELEASE
    string "Linux ABI release"
    default "6.12.0-edgeos"
    help
      Release reported by Linux ABI interfaces such as uname and procfs.
      Keep this architecture-neutral so Linux userspace selects the same
      feature set on every supported architecture.

config SYSFS_SYSCALL
    bool "Legacy Linux sysfs system call"
    default y
    help
      Enable the obsolete sysfs system call used to enumerate registered
      filesystem types. Disable it to expose the same ENOSYS behavior as a
      Linux kernel built without CONFIG_SYSFS_SYSCALL.

config SMP
    bool "Symmetric multiprocessing"
    default y
    help
      Enable architecture secondary CPU startup and the shared per-CPU
      scheduler, interrupt, memory-ordering, and hotplug foundations.

config NR_CPUS
    int "Maximum supported CPUs"
    depends on SMP
    range 2 256
    default 64
    help
      Compile-time storage ceiling for per-CPU kernel objects. Runtime CPU
      masks retain the firmware-discovered width and are not limited to one
      64-bit word.

config BSD_DRIVER_BRIDGE
    bool "FreeBSD source-compatible driver bridge"
    default n
    help
      Build the shared compatibility services used to compile unmodified
      BSD-licensed driver sources. Driver families remain separately
      selectable and must pass their device-specific runtime tests.

config BSD_DRIVER_ACPICA
    bool "Complete ACPICA namespace and method runtime"
    depends on BSD_DRIVER_BRIDGE && ACPI
    default y
    help
      Build the vendored ACPICA runtime with the shared EdgeOS operating-
      system layer. This enables firmware namespace enumeration and method
      execution required by laptop I2C, HID, battery, button, and thermal
      drivers.

config BSD_DRIVER_MODULES
    bool "Load source-built BSD drivers from relocatable modules"
    depends on BSD_DRIVER_BRIDGE
    default y
    help
      Enable the shared ELF64 and ARM64 COFF object loader so driver
      packages can remain outside the kernel image and load from the root
      filesystem.

config MODULES
    bool "Linux module loading UAPI"
    depends on BSD_DRIVER_MODULES
    default y
    help
      Expose Linux init_module, finit_module, and delete_module system calls
      over the source-built EdgeOS module loader. Public flags and errors
      follow the selected Linux UAPI release.

config SYSVIPC
    bool "System V IPC"
    default y
    help
      Enable Linux-compatible shared memory, semaphore arrays, and message
      queues with IPC namespace isolation and common cross-architecture
      policy.

config CHECKPOINT_RESTORE
    bool "Checkpoint and restore support"
    default y
    help
      Enable Linux checkpoint and restore UAPI details implemented by
      supported subsystems, including nondestructive SysV message reads.

config POSIX_MQUEUE
    bool "POSIX message queues"
    default y
    help
      Enable Linux-compatible named POSIX message queues, descriptors,
      notification, polling, and IPC namespace isolation.

config AIO
    bool "Legacy Linux asynchronous I/O"
    default y
    help
      Enable Linux io_setup, io_submit, io_getevents, io_cancel, and
      io_destroy over the shared descriptor I/O runtime.

config IO_URING
    bool "Linux io_uring"
    default y
    help
      Enable Linux io_uring setup, shared submission and completion rings,
      registration, and asynchronous descriptor operations.

config QUOTA
    bool "Linux filesystem quotas"
    default y
    help
      Enable Linux quotactl and quotactl_fd control, quota formats, grace
      information, and per-user, per-group, and per-project limit records.

config BSD_PROCESS_ACCT
    bool "BSD process accounting"
    default y
    help
      Enable Linux acct and version 3 process accounting records, including
      per-PID-namespace output files and thread-group exit aggregation.

config KEYS
    bool "Linux key retention service"
    default y
    help
      Enable Linux add_key, request_key, and keyctl over the shared keyring,
      permission, payload, search, timeout, and persistent-keyring runtime.

config FANOTIFY
    bool "Linux fanotify notification service"
    default y
    help
      Enable Linux fanotify notification groups, inode marks, event queues,
      polling, and event file descriptors over the shared VFS event source.

config USERFAULTFD
    bool "Linux userfaultfd missing-page service"
    default y
    help
      Enable Linux userfaultfd missing-page registration, page-fault events,
      polling, and userspace COPY, ZEROPAGE, and WAKE resolution.

config PERF_EVENTS
    bool "Linux performance events"
    default y
    help
      Enable Linux perf_event_open software counters, event groups,
      descriptor reads, and event control operations.

config BPF_SYSCALL
    bool "Linux BPF system call"
    default y
    help
      Enable Linux BPF object descriptors, hash and array maps, verified
      cgroup-device programs, object enumeration, and information queries.

config LANDLOCK
    bool "Linux Landlock filesystem access control"
    default y
    help
      Enable Linux Landlock rulesets, path-beneath rules, stacked task
      domains, and cross-architecture VFS enforcement.

config RSEQ
    bool "Linux restartable sequences"
    default y
    help
      Enable per-thread restartable-sequence registration, CPU and memory
      concurrency identifiers, critical-section aborts, and Linux rseq UAPI.

config RSEQ_SLICE_EXTENSION
    bool "Restartable-sequence time-slice extension"
    depends on RSEQ
    default y
    help
      Enable Linux rseq v2 time-slice requests, PR_RSEQ_SLICE_EXTENSION,
      and rseq_slice_yield over the shared scheduler integration.

config BSD_DRIVER_FDT_INVENTORY
    bool "Inventory Device Tree devices for BSD drivers"
    depends on BSD_DRIVER_BRIDGE && DEVICE_TREE
    default y
    help
      Create a non-attaching newbus inventory from the validated firmware
      Device Tree. Imported drivers may claim matching devices after their
      modules load, while native EdgeOS drivers retain ownership by default.

config BSD_DRIVER_MODULE_DIRECTORY
    string "BSD driver module directory"
    depends on BSD_DRIVER_MODULES
    default "/usr/lib/edgeos/modules"
    help
      Absolute directory containing source-built BSD driver modules. Bare
      entries in the module list resolve below this directory.

config BSD_DRIVER_MODULE_AUTOLOAD
    bool "Load BSD driver modules during boot"
    depends on BSD_DRIVER_MODULES
    default y
    help
      Load the ordered module list after built-in compatibility services
      start and before buses attach devices.

config BSD_DRIVER_MODULE_CONFIG
    string "BSD driver module list"
    depends on BSD_DRIVER_MODULE_AUTOLOAD
    default "/etc/modules.load"
    help
      Absolute path to the ordered module list in the initial root
      filesystem. Bare names resolve below BSD_DRIVER_MODULE_DIRECTORY.

endmenu

menu "Boot options"

config INITRAMFS
    bool "Linux initramfs cpio support"
    default y
    help
      Unpack Linux-compatible newc and crc cpio archives as the initial root
      filesystem. Both x86_64 Multiboot modules and ARM64 UEFI handoff images
      use the same architecture-neutral unpacker.

config INITRAMFS_SOURCE
    string "Initramfs source directory"
    depends on INITRAMFS
    default ""
    help
      Directory packed by the initramfs build target. Leave this empty when an
      externally generated archive is supplied by the boot loader.

config INITRAMFS_MAX_INODES
    int "Maximum initramfs inode count"
    depends on INITRAMFS
    range 512 65536
    default 8192
    help
      Maximum number of files, directories, links, and device nodes in the
      initial root filesystem. Metadata storage is allocated only when the
      initramfs root is mounted.

config INITRAMFS_MAX_BYTES
    int "Maximum uncompressed initramfs size"
    depends on INITRAMFS
    range 1048576 1073741824
    default 268435456
    help
      Reject compressed initial root filesystems whose advertised
      uncompressed size exceeds this bound.

config INITRAMFS_GZIP
    bool "gzip-compressed initramfs support"
    depends on INITRAMFS
    default y
    help
      Decode gzip-compressed initial root filesystems with the permissively
      licensed zlib implementation imported with the FreeBSD source tree.

config INITRAMFS_COMPRESSION_GZIP
    bool "Compress generated initramfs images with gzip"
    depends on INITRAMFS_GZIP
    default y
    help
      Make initramfs build targets emit deterministic gzip streams instead of
      uncompressed cpio files.

config INITRAMFS_CRC
    bool "Generate crc cpio archives"
    depends on INITRAMFS && INITRAMFS_SOURCE != ""
    default n
    help
      Generate the Linux crc cpio variant and verify each payload while
      unpacking. The default newc format omits payload checksums.

endmenu

source "arch/x86/Kconfig"
```

## arch/arm64/configs/arm64_buildroot_defconfig
```kconfig
# Experimental serial Buildroot profile; not a low-memory acceptance result.
CONFIG_DEVTMPFS_MOUNT=y
CONFIG_RUNTIME_EXEC_ARGUMENT_BYTES=131072
CONFIG_RUNTIME_ARM64_VMA_MIN_ORDER=8
CONFIG_RUNTIME_ARM64_FILE_PAGE_MIN_ORDER=10
CONFIG_RUNTIME_CGROUP_NODES=128
CONFIG_RUNTIME_ARM64_MAPPING_ORDER=16
# CONFIG_ARM64_MATERIALIZE_DATA is not set
CONFIG_RUNTIME_RIGHTS_RECORDS=256
CONFIG_RUNTIME_MQ_MESSAGES=64
CONFIG_RUNTIME_MEMFD_OBJECTS=8
CONFIG_RUNTIME_FILE_DESCRIPTION_ORDER=9
CONFIG_RUNTIME_OVERLAY_INITIAL_CONTEXTS=2
CONFIG_RUNTIME_PIPE_CAPACITY=4096
CONFIG_RUNTIME_IO_URING_RINGS=1
CONFIG_RUNTIME_KEY_OBJECTS=1
CONFIG_RUNTIME_KEY_TASKS=1
CONFIG_RUNTIME_DRM_BUFFERS=1
CONFIG_RUNTIME_FRAMEBUFFER_BYTES=4096
CONFIG_RUNTIME_TMPFS_BLOCK_ORDER=12
# Full-system defconfigs are independent and retain all existing defaults.
# CONFIG_ARCH_X86_64 is not set
CONFIG_ARCH_ARM64=y
CONFIG_SYSFS_SYSCALL=y
# CONFIG_SMP is not set
# CONFIG_BSD_DRIVER_BRIDGE is not set
# CONFIG_BSD_DRIVER_ACPICA is not set
# CONFIG_BSD_DRIVER_MODULES is not set
# CONFIG_MODULES is not set
# CONFIG_SYSVIPC is not set
# CONFIG_CHECKPOINT_RESTORE is not set
# CONFIG_POSIX_MQUEUE is not set
# CONFIG_AIO is not set
# CONFIG_IO_URING is not set
# CONFIG_QUOTA is not set
# CONFIG_BSD_PROCESS_ACCT is not set
# CONFIG_KEYS is not set
# CONFIG_WATCH_QUEUE is not set
# CONFIG_KEY_NOTIFICATIONS is not set
# CONFIG_FANOTIFY is not set
# CONFIG_USERFAULTFD is not set
# CONFIG_SECRETMEM is not set
# CONFIG_PERF_EVENTS is not set
# CONFIG_BPF_SYSCALL is not set
# CONFIG_LANDLOCK is not set
# CONFIG_RSEQ is not set
# CONFIG_RSEQ_SLICE_EXTENSION is not set
# CONFIG_BSD_DRIVER_FDT_INVENTORY is not set
# CONFIG_BSD_DRIVER_MODULE_AUTOLOAD is not set
# CONFIG_EDGE_KVM is not set
# CONFIG_EDGE_KVM_BHYVE is not set
CONFIG_INITRAMFS=y
CONFIG_INITRAMFS_GZIP=y
CONFIG_INITRAMFS_COMPRESSION_GZIP=y
# CONFIG_INITRAMFS_CRC is not set
# CONFIG_COMPAT_IA32 is not set
# CONFIG_UID16 is not set
# CONFIG_X86_X32_ABI is not set
# CONFIG_MODIFY_LDT_SYSCALL is not set
# CONFIG_X86_16BIT is not set
# CONFIG_APIC is not set
# CONFIG_IOAPIC is not set
# CONFIG_CPUFREQ_INTEL_PSTATE is not set
CONFIG_ACPI=y
# CONFIG_ACPI_AC_ADAPTER is not set
# CONFIG_ACPI_BATTERY is not set
# CONFIG_ACPI_EC is not set
# CONFIG_ACPI_DOCK is not set
# CONFIG_ACPI_POWER_RESOURCE is not set
# CONFIG_ACPI_BUTTON is not set
# CONFIG_HPET is not set
CONFIG_RTC=y
# CONFIG_ACPI_THERMAL is not set
# CONFIG_FAN_CONTROLLER is not set
# CONFIG_PCI is not set
# CONFIG_PCIE is not set
# CONFIG_PCI_DRIVER_PROBE is not set
# CONFIG_PCI_MSI is not set
# CONFIG_PCI_MSIX is not set
# CONFIG_SMBUS is not set
# CONFIG_I2C is not set
CONFIG_DEVICE_TREE=y
# CONFIG_EFI_RUNTIME is not set
# CONFIG_EFI_GOP is not set
# CONFIG_LOOP_DEVICE is not set
# CONFIG_DEVICE_MAPPER is not set
CONFIG_VIRTIO_BLK=y
# CONFIG_VIRTIO_SCSI is not set
# CONFIG_NVME is not set
# CONFIG_AHCI is not set
# CONFIG_ATA is not set
# CONFIG_VMWARE_PVSCSI is not set
CONFIG_NET=y
# CONFIG_E1000 is not set
# CONFIG_NET_INTEL_E1000E is not set
# CONFIG_NET_INTEL_IGC is not set
# CONFIG_NET_REALTEK_R8169 is not set
CONFIG_VIRTIO_NET=y
# CONFIG_WIFI_INTEL_IWLWIFI is not set
# CONFIG_VMWARE_VMXNET3 is not set
# CONFIG_HYPERV_NETVSC is not set
# CONFIG_USB is not set
# CONFIG_USB_HUB is not set
# CONFIG_USB_HID_KEYBOARD is not set
# CONFIG_USB_HID_MOUSE is not set
# CONFIG_USB_AUDIO is not set
# CONFIG_USB_UVC is not set
# CONFIG_USB_STORAGE is not set
# CONFIG_USB_UHCI is not set
# CONFIG_USB_EHCI is not set
# CONFIG_USB_OHCI is not set
# CONFIG_USB_XHCI is not set
# CONFIG_USB_ETH_ASIX is not set
# CONFIG_USB_ETH_RTL8153 is not set
# CONFIG_PS2_KEYBOARD is not set
# CONFIG_PS2_MOUSE is not set
# CONFIG_TOUCHPAD_SYNAPTICS is not set
# CONFIG_TOUCHPAD_ELAN is not set
# CONFIG_VIRTIO_INPUT is not set
# CONFIG_FB_CONSOLE is not set
# CONFIG_GRAPHICS_BGA is not set
# CONFIG_GRAPHICS_VBE is not set
# CONFIG_GRAPHICS_INTEL is not set
# CONFIG_GRAPHICS_AMD is not set
# CONFIG_GRAPHICS_NVIDIA is not set
# CONFIG_VMWARE_SVGA is not set
# CONFIG_VIRTIO_GPU is not set
# CONFIG_AUDIO_HDA is not set
# CONFIG_AUDIO_AC97 is not set
# CONFIG_VIRTIO_RNG is not set
# CONFIG_VIRTIO_BALLOON is not set
# CONFIG_VIRTIO_CONSOLE is not set
# CONFIG_VIRTIO_FS is not set
# CONFIG_SERIAL_16550 is not set
# CONFIG_TPM2 is not set
# CONFIG_WATCHDOG is not set
# CONFIG_GPIO is not set
# CONFIG_LED_CLASS is not set
# CONFIG_HYPERV_STORVSC is not set
# CONFIG_FS_SWAP is not set
# CONFIG_FS_EXT2 is not set
CONFIG_FS_EXT4=y
# CONFIG_FS_FAT32 is not set
# CONFIG_FS_EXFAT is not set
# CONFIG_FS_NTFS is not set
# CONFIG_FS_ISO9660 is not set
# CONFIG_FS_UDF is not set
# CONFIG_FS_SQUASHFS is not set
# CONFIG_FS_EROFS is not set
# CONFIG_FS_XFS is not set
# CONFIG_FS_BTRFS is not set
# CONFIG_NFSD is not set
# CONFIG_FUSE_FS is not set
# CONFIG_FUSE_IO_URING is not set
# CONFIG_OVERLAY_FS is not set
CONFIG_INITRAMFS_MAX_INODES=512
CONFIG_INITRAMFS_MAX_BYTES=8388608
CONFIG_RUNTIME_MAX_TASKS=32
CONFIG_RUNTIME_MAX_OPEN_FILES=32
CONFIG_RUNTIME_MAX_PIPES=32
CONFIG_RUNTIME_MAX_SOCKETS=32
CONFIG_RUNTIME_MAX_EVENTFDS=16
CONFIG_RUNTIME_MAX_TIMERFDS=16
CONFIG_RUNTIME_MAX_SIGNALFDS=16
CONFIG_RUNTIME_MAX_INOTIFY_INSTANCES=16
CONFIG_RUNTIME_MAX_INOTIFY_WATCHES=16
CONFIG_RUNTIME_MAX_FANOTIFY_GROUPS=16
CONFIG_RUNTIME_MAX_FANOTIFY_MARKS=16
CONFIG_RUNTIME_MAX_USERFAULTFDS=16
CONFIG_RUNTIME_MAX_USERFAULTFD_RANGES=16
CONFIG_RUNTIME_MAX_PERF_EVENTS=16
CONFIG_RUNTIME_MAX_BPF_OBJECTS=16
CONFIG_RUNTIME_MAX_BPF_ATTACHMENTS=16
CONFIG_RUNTIME_MAX_QUOTA_FILESYSTEMS=16
CONFIG_RUNTIME_MAX_QUOTA_ENTRIES=16
CONFIG_RUNTIME_MAX_FUSE_SESSIONS=16
CONFIG_RUNTIME_SIGNAL_QUEUE_SIZE=16
CONFIG_RUNTIME_MAX_EPOLL_IDS=32
CONFIG_RUNTIME_MAX_EPOLL_WATCHES=16
CONFIG_RUNTIME_SOCKET_BACKLOG=16
```
